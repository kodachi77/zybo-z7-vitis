/include/ "system-conf.dtsi"
/ {
	model = "Zynq Zybo Z7 Development Board";
	compatible = "digilent,zynq-zyboz7", "xlnx,zynq-7000";

	/*chosen {
		bootargs = "console=ttyPS0,115200 earlyprintk uio_pdrv_genirq.of_id=generic-uio";
	};

	usb_phy0: usb_phy@0 {
		compatible = "ulpi-phy";
		#phy-cells = <0>;
		reg = <0xe0002000 0x1000>;
		view-port = <0x0170>;
		drv-vbus;
	};*/
};

&gem0 {
        phy-handle = <&ethernet_phy>;
        ethernet_phy: ethernet-phy@0 {
                device_type = "ethernet-phy";
                reg = <0>;
                /* dt-bindings/phy/realtek.h */
                /* #define REALTEK_LED_LINK10              BIT(0)
                   #define REALTEK_LED_LINK100             BIT(1)
                   #define REALTEK_LED_LINK1000            BIT(3)
                   #define REALTEK_LED_ACT                 BIT(4)
                   #define REALTEK_LED_DEFAULT             BIT(7)
                */
                /* LED0=10+A, LED1=100+A, LED2=1000+A */
                realtek,leds-config = <0x11 0x12 0x18>;
        };
};

	/*amba {
		zyxclmm_drm {
			compatible = "xlnx,zocl";
			status = "okay";
		};

	};*/
};

/*&usb0 {	
	dr_mode = "host";
	usb-phy = <&usb_phy0>;
};*/

